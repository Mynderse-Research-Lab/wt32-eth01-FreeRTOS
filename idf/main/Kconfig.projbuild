## idf/main/Kconfig.projbuild
```kconfig
menu "Gantry application"

    config GANTRY_SELFTEST
        bool "Enable on-target selftest console command"
        default y
        help
            When enabled, the interactive serial console exposes the
            "selftest" command, which runs runBasicTests() (kinematics,
            joint-limit, and trajectory sanity checks) directly on the target.

            The same assertions also run host-side in CI (test/host/), so a
            production build can set this to "n" to drop both the "selftest"
            command and the basic_tests.cpp source from the firmware without
            losing test coverage.

    config GANTRY_SUPPRESS_GEOMETRY_WARNING
        bool "Suppress dev-rig geometry compile reminder"
        default n
        help
            axis_drivetrain_params.h emits a #warning when gantry geometric
            offsets are still development-rig placeholders. ESP-IDF v6 treats
            that as a build error (-Werror=cpp).

            Enable this for CI or bring-up builds that knowingly use unfrozen
            geometry. Local developer builds should leave this disabled so the
            one-time reminder in main.cpp stays visible.

            Equivalent to defining GANTRY_SUPPRESS_GEOMETRY_WARNING in C.

endmenu

menu "Gantry kinematics"

    menu "Default motion profile (console / Gantry)"
        config GANTRY_DEFAULT_SPEED_MM_PER_S
            int "Default 2-D path speed (mm/s)"
            default 50
            range 1 2000
            help
                Boot default for console `speed` / Gantry moves until overridden.
                Value is the RESULTANT along the X-Z path; per-axis Absolute
                components are derived from path direction.

        config GANTRY_DEFAULT_SPEED_DEG_PER_S
            int "Default theta speed (deg/s)"
            default 30
            range 1 7200

        config GANTRY_DEFAULT_ACCEL_MM_PER_S2
            int "Default 2-D path accel (mm/s^2)"
            default 3000
            range 1 50000
            help
                Boot default for console `accel`. Also used as decel when
                `accel` is given without a separate decel argument. Resultant
                along the X-Z path.

        config GANTRY_DEFAULT_DECEL_MM_PER_S2
            int "Default 2-D path decel (mm/s^2)"
            default 3000
            range 1 50000

        config GANTRY_DEFAULT_ACCEL_DEG_PER_S2
            int "Default theta accel (deg/s^2)"
            default 180
            range 1 18000
            help
                Boot default for console `accel` theta arguments / Gantry
                theta moves until overridden. Conservative vs AXIS_THETA_ACCEL.

        config GANTRY_DEFAULT_DECEL_DEG_PER_S2
            int "Default theta decel (deg/s^2)"
            default 180
            range 1 18000

        config GANTRY_PATH_MAX_SPEED_MM_PER_S
            int "2-D path speed ceiling (mm/s)"
            default 500
            range 1 2000
            help
                Console rangelimit ceiling for path speed. Z ballscrew
                critical-RPM derived cap is still applied as a protective clamp.

        config GANTRY_PATH_MAX_ACCEL_MM_PER_S2
            int "2-D path accel ceiling (mm/s^2)"
            default 3000
            range 1 50000
            help
                Console rangelimit ceiling for path accel/decel.

        config GANTRY_PATH_MAX_DECEL_MM_PER_S2
            int "2-D path decel ceiling (mm/s^2)"
            default 3000
            range 1 50000

        config GANTRY_EIP_ASSUMED_STOP_DECEL_MM_S2
            int "EIP TM10 assumed stop decel (mm/s^2)"
            default 300
            range 50 5000
            help
                Conservative deceleration used to cap cruise speed and time
                StopMotion on Kinetix Speed+TravelMode=10 (drive ignores large
                DecelReference). Bench-tuned ~300–450 mm/s^2.
    endmenu

    menu "X axis (belt)"
        config AXIS_X_LEAD_MM_PER_REV
            float "Lead (mm per motor-side rev)"
            default 200.0
        config AXIS_X_HARD_LIMIT_MIN_MM
            float "Hard limit min (mm)"
            default 0.0
        config AXIS_X_HARD_LIMIT_MAX_MM
            float "Hard limit max (mm)"
            default 550.0
        config AXIS_X_MAX_SPEED_MM_PER_S
            float "Max speed clamp (mm/s) [docs only]"
            default 500.0
            help
                Commissioning documentation. Console envelope uses
                GANTRY_PATH_MAX_SPEED_MM_PER_S.
        config AXIS_X_ACCEL_MM_PER_S2
            float "Axis accel envelope (mm/s^2) [docs only]"
            default 3000.0
            help
                Commissioning documentation. Not a console ceiling.
        config AXIS_X_DECEL_MM_PER_S2
            float "Axis decel envelope (mm/s^2) [docs only]"
            default 3000.0
            help
                Commissioning documentation. Not a console ceiling.
        config AXIS_X_POSITION_TOLERANCE_MM
            float "Position tolerance (mm)"
            default 0.08
        config AXIS_X_ENCODER_PPR
            int "PUU / encoder counts per motor rev"
            default 2097152
            range 1 16777216
        config AXIS_X_MOTOR_REDUCER_RATIO
            float "Gearbox ratio (motor:load, e.g. 5.0 for 5:1)"
            default 5.0
        config AXIS_X_HOMING_SPEED_PPS
            int "Homing speed (pulses/s, pulse-motor path)"
            default 8000
    endmenu

    menu "Z axis (ballscrew)"
        config AXIS_Z_LEAD_MM_PER_REV
            float "Lead / pitch (mm per motor-side rev)"
            default 20.0
        config AXIS_Z_CRITICAL_RPM
            int "Ballscrew critical RPM"
            default 3000
            range 100 10000
        config AXIS_Z_HARD_LIMIT_MIN_MM
            float "Hard limit min (mm)"
            default 0.0
        config AXIS_Z_HARD_LIMIT_MAX_MM
            float "Hard limit max (mm)"
            default 150.0
        config AXIS_Z_MAX_SPEED_MM_PER_S
            float "Max speed clamp (mm/s) [docs only]"
            default 500.0
            help
                Commissioning documentation. Critical-RPM derived cap still
                protects the ballscrew; console envelope uses GANTRY_PATH_MAX_*.
        config AXIS_Z_ACCEL_MM_PER_S2
            float "Axis accel envelope (mm/s^2) [docs only]"
            default 5000.0
            help
                Commissioning documentation. Not a console ceiling.
        config AXIS_Z_DECEL_MM_PER_S2
            float "Axis decel envelope (mm/s^2) [docs only]"
            default 5000.0
            help
                Commissioning documentation. Not a console ceiling.
        config AXIS_Z_POSITION_TOLERANCE_MM
            float "Position tolerance (mm)"
            default 0.03
        config AXIS_Z_ENCODER_PPR
            int "PUU / encoder counts per motor rev"
            default 2097152
            range 1 16777216
        config AXIS_Z_MOTOR_REDUCER_RATIO
            float "Gearbox ratio (motor:load; 1.0 = direct drive)"
            default 1.0
            help
                Z is direct-drive (no reducer). Use 1.0 unless a gearbox is added.

        config AXIS_Z_HAS_MOTOR_BRAKE
            bool "Z motor has a holding brake"
            default n
            help
                Z is commissioned as direct-drive without a motor holding brake.
                Leave disabled: firmware does not drive brake DO, and KNX5100C
                should not assign Digital Output to Brake Control on this axis.

                WARNING: without a brake, Servo Off / disable / fault will not
                hold a vertical load — keep Z enabled while supporting mass, or
                support the axis mechanically before disable.
        config AXIS_Z_HOMING_SPEED_PPS
            int "Homing speed (pulses/s, pulse-motor path)"
            default 8000
        config GANTRY_Z_DATUM_OFFSET_ABOVE_BED_MM
            float "Z datum offset above bed (mm, +Z up)"
            default 0.0
    endmenu

    menu "Theta axis (rotary)"
        config GANTRY_THETA_SEQUENTIAL
            bool "Sequential Theta choreography"
            default n
            depends on EIP_AXIS_THETA
            help
                If enabled, Theta moves sequentially after the X-axis completes its move.
                If disabled, Theta moves simultaneously with the X-axis.
        config AXIS_THETA_OUTPUT_GEAR_RATIO
            float "Output gear ratio (output_rev/motor_rev)"
            default 1.0
        config AXIS_THETA_HARD_LIMIT_MIN_DEG
            float "Hard limit min (deg)"
            default -180.0
        config AXIS_THETA_HARD_LIMIT_MAX_DEG
            float "Hard limit max (deg)"
            default 180.0
        config AXIS_THETA_MAX_SPEED_DEG_PER_S
            float "Max speed (deg/s)"
            default 3600.0
        config AXIS_THETA_ACCEL_DEG_PER_S2
            float "Accel (deg/s^2)"
            default 18000.0
        config AXIS_THETA_DECEL_DEG_PER_S2
            float "Decel (deg/s^2)"
            default 18000.0
        config AXIS_THETA_POSITION_TOLERANCE_DEG
            float "Position tolerance (deg)"
            default 0.01
        config AXIS_THETA_ENCODER_PPR
            int "Encoder pulses per motor rev"
            default 36000
        config AXIS_THETA_MOTOR_REDUCER_RATIO
            float "Motor reducer ratio"
            default 1.0
        config AXIS_THETA_HOMING_SPEED_PPS
            int "Homing speed (pulses/s)"
            default 6000
    endmenu

    menu "Gantry geometry and gripper"
        config GANTRY_Z_AXIS_Y_OFFSET_MM
            float "Z-column Y offset from X beam (mm)"
            default 80.0
        config GANTRY_THETA_X_OFFSET_MM
            float "Theta X offset from Z column (mm)"
            default -55.0
        config GANTRY_GRIPPER_X_OFFSET_MM
            float "Gripper TCP X offset from theta (mm)"
            default 385.0
        config GANTRY_GRIPPER_Z_OFFSET_MM
            float "Gripper TCP Z offset from theta (mm)"
            default 80.0
        config GANTRY_SAFE_Z_HEIGHT_MM
            float "Z+ clearance margin (mm below Z+)"
            default 35.7
            help
                Coordinated X+Z Absolute only while joint Z is within this
                margin of Z+ (band floor = z_max - this). Below that band,
                Z moves alone with X held. Limit codes match X (A014/A015).

        config GANTRY_CAL_X_PARK_MM
            float "X park before Z+ seek (mm)"
            default 35.0
            help
                During EIP bring-up calibrate-all: after X stroke is measured,
                move to this X before seeking Z+ (stroke).
        config GANTRY_GRIPPER_OPEN_TIME_MS
            int "Gripper open time (ms)"
            default 190
        config GANTRY_GRIPPER_CLOSE_TIME_MS
            int "Gripper close time (ms)"
            default 150
    endmenu

endmenu

menu "LAN8720 plant Ethernet"

    config ETH_USE_STATIC_IP
        bool "Use static IP on LAN8720 (TCP console)"
        default y
        help
            When enabled, assign a fixed IPv4 address (typical for a dumb
            lab switch with no DHCP). When disabled, start the DHCP client.

    config ETH_STATIC_IP
        string "LAN8720 static IP address"
        default "192.168.1.100"
        depends on ETH_USE_STATIC_IP

    config ETH_STATIC_GATEWAY
        string "LAN8720 static gateway"
        default "192.168.1.5"
        depends on ETH_USE_STATIC_IP

    config ETH_STATIC_NETMASK
        string "LAN8720 static netmask"
        default "255.255.255.0"
        depends on ETH_USE_STATIC_IP

    config ETH_IP_WAIT_TIMEOUT_MS
        int "Wait for LAN8720 PHY+IP (ms)"
        default 3000
        range 100 60000
        help
            How long Bridge / net-console bring-up waits for link+IP.
            Keep short so EIP continues when the plant cable is unplugged.

endmenu

menu "TCP gantry console (LAN8720)"

    config CONSOLE_TCP_ENABLE
        bool "Enable TCP diagnostic console"
        default y
        help
            Listen on LAN8720 for the same gantry commands as the UART
            console, plus a session-long ESP_LOG stream. Does not use
            the W5500 EIP daisy-chain.

    config CONSOLE_UART_ENABLE
        bool "Enable UART0 diagnostic console (GPIO1/3)"
        default n
        help
            When disabled (recommended for plant bring-up), the SerialCmd
            UART task is not started and sdkconfig should use
            CONFIG_ESP_CONSOLE_NONE so GPIO1/TX and GPIO3/RX are free.
            Use the TCP console / tools/lan_debug_ui.py instead.

    config CONSOLE_TCP_PORT
        int "TCP listen port"
        default 2323
        range 1 65535
        depends on CONSOLE_TCP_ENABLE

    config CONSOLE_TCP_AUTH_ENABLE
        bool "Require password on TCP connect"
        default y
        depends on CONSOLE_TCP_ENABLE
        help
            UART console is unaffected. Recent peer IPs may skip the
            prompt for CONSOLE_TCP_AUTH_REMEMBER_S seconds.

    config CONSOLE_TCP_PASSWORD
        string "TCP console password"
        default "LTU_1932"
        depends on CONSOLE_TCP_AUTH_ENABLE

    config CONSOLE_TCP_AUTH_MAX_TRIES
        int "Max password attempts per connection"
        default 3
        range 1 10
        depends on CONSOLE_TCP_AUTH_ENABLE

    config CONSOLE_TCP_AUTH_REMEMBER_S
        int "Remember authenticated peer IP (seconds)"
        default 600
        range 0 86400
        depends on CONSOLE_TCP_AUTH_ENABLE
        help
            Sliding TTL: resets on each reconnect from that IP. 0 means
            never skip the password prompt.

    config CONSOLE_TCP_AUTH_REMEMBER_MAX
        int "Max remembered peer IPs"
        default 4
        range 1 16
        depends on CONSOLE_TCP_AUTH_ENABLE

    config CONSOLE_TCP_LOG_ENABLE
        bool "Stream ESP_LOG over TCP (LAN logging)"
        default y
        depends on CONSOLE_TCP_ENABLE
        help
            When enabled, authenticated TCP sessions receive a filtered
            ESP_LOG stream (same lines as UART). Command replies still
            work when this is disabled.

    choice CONSOLE_TCP_LOG_LEVEL
        prompt "Minimum LAN log level"
        default CONSOLE_TCP_LOG_LEVEL_INFO
        depends on CONSOLE_TCP_LOG_ENABLE
        help
            Only lines at this severity or higher are forwarded to the
            TCP client. ERR < WARN < INFO < DBUG.

        config CONSOLE_TCP_LOG_LEVEL_ERR
            bool "ERR (errors only)"
        config CONSOLE_TCP_LOG_LEVEL_WARN
            bool "WARN (errors + warnings)"
        config CONSOLE_TCP_LOG_LEVEL_INFO
            bool "INFO (errors + warnings + info)"
        config CONSOLE_TCP_LOG_LEVEL_DBUG
            bool "DBUG (all levels including debug/verbose)"
    endchoice

endmenu
```
